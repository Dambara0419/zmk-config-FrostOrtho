## config/west.yml
```yaml
manifest:
  remotes:
    - name: zmkfirmware
      url-base: https://github.com/zmkfirmware
    - name: caksoylar
      url-base: https://github.com/caksoylar
    - name: sekigon-gonnoc  # PAW3222（上流）
      url-base: https://github.com/sekigon-gonnoc
    - name: Dambara0419  # PAW3222 のフォーク（ポーリング間隔を設定可能にしたもの）
      url-base: https://github.com/Dambara0419
    - name: cormoran
      url-base: https://github.com/cormoran
    - name: imo00o
      url-base: https://github.com/imo00o
  projects:
    #　- name: zmk
    #   remote: zmkfirmware
    #   revision: v0.3.0
    - name: zmk
      remote: cormoran
      revision: v0.3-branch+dya
      import: app/west.yml
    # 上流 sekigon-gonnoc/main は移動中の読み取り間隔が 15ms 固定。
    # フォークの poll-interval ブランチで CONFIG_PAW3222_POLL_INTERVAL_MS を追加している。
    - name: zmk-driver-paw3222
      remote: Dambara0419
      revision: poll-interval
    - name: zmk-rgbled-widget
      remote: caksoylar
      revision: v0.3.0
    # DYA Studio モジュール
    - name: zmk-module-ble-management
      remote: cormoran
      revision: zmk-v0.3.0.0
    - name: zmk-module-battery-history
      remote: cormoran
      revision: main
    - name: zmk-module-settings-rpc
      remote: cormoran
      revision: zmk-v0.3.0.0
    - name: zmk-module-runtime-input-processor
      remote: cormoran
      revision: zmk-v0.3.0.0
    - name: zmk-behavior-runtime-sensor-rotate
      remote: cormoran
      revision: zmk-v0.3.0.0
  self:
    path: config
```
